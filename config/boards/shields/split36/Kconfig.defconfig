## config/boards/shields/split36/Kconfig.defconfig
```kconfig
if SHIELD_SPLIT36_RIGHT

config ZMK_KEYBOARD_NAME
	default "Split"

config ZMK_SPLIT_BLE_ROLE_CENTRAL
	default y

config ZMK_USB
	default y

endif

if SHIELD_SPLIT36_LEFT || SHIELD_SPLIT36_RIGHT

config ZMK_SPLIT
	default y

config ZMK_BLE
	default y

endif
```
